/ {
    chosen {
        zmk,kscan = &kscan0;
    };

    kscan0: kscan_0 {
        compatible = "zmk,kscan-gpio-matrix";
        label = "KSCAN";

        diode-direction = "col2row";

        row-gpios
            = <&gpio0 9  (GPIO_ACTIVE_HIGH | GPIO_PULL_DOWN)>   /* Reihe 1 → P1_06 */
            , <&gpio0 10  (GPIO_ACTIVE_HIGH | GPIO_PULL_DOWN)>   /* Reihe 2 → P1_04 */
            , <&gpio1 11 (GPIO_ACTIVE_HIGH | GPIO_PULL_DOWN)>   /* Reihe 3 → P0_11 */
            ;

        col-gpios
            = <&gpio1 13  GPIO_ACTIVE_HIGH>   /* Spalte 1 → P1_00 */
            , <&gpio1 15 GPIO_ACTIVE_HIGH>   /* Spalte 2 → P0_24 */
            , <&gpio0 2 GPIO_ACTIVE_HIGH>   /* Spalte 3 → P0_22 */
            ;
    };
};